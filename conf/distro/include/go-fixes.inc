## conf/distro/include/go-fixes.inc
```bitbake
CFLAGS_SECTION_REMOVAL:pn-containerd-opencontainers = ""
LDFLAGS_SECTION_REMOVAL:pn-containerd-opencontainers = ""
CFLAGS_SECTION_REMOVAL:pn-go-runtime = ""
LDFLAGS_SECTION_REMOVAL:pn-go-runtime = ""
CFLAGS_SECTION_REMOVAL:pn-go = ""
LDFLAGS_SECTION_REMOVAL:pn-go = ""
```

## conf/distro/rodeos.conf
```bitbake
DISTRO = "rodeos"
DISTRO_NAME = "rodeOS (Minimal Kubernetes Distro)"
DISTRO_VERSION = "0.1"
DISTRO_CODENAME = "kirkstone"
SDK_VENDOR = "-rodeossdk"
SDK_VERSION = "${@d.getVar('DISTRO_VERSION').replace('snapshot-${METADATA_REVISION}', 'snapshot')}"
SDK_VERSION[vardepvalue] = "${SDK_VERSION}"

MAINTAINER = "Anthony Davies <anthony.t.davies@gmail.com>"

TARGET_VENDOR = "-phx"

LOCALCONF_VERSION = "2"

# Override these in poky based distros
POKY_DEFAULT_DISTRO_FEATURES = "largefile ptest multiarch"
POKY_DEFAULT_EXTRA_RDEPENDS = "packagegroup-core-boot"
POKY_DEFAULT_EXTRA_RRECOMMENDS = "kernel-module-af-packet"

DISTRO_FEATURES ?= " \
            seccomp \
            virtualization \
            sysvinit \
            k8s \
            ipv4 ipv6 \
            usbhost \
            usbgadget \
            "

PREFERRED_PROVIDER_virtual/kernel = "linux-rodeos"
PREFERRED_VERSION_linux-rodeos ?= "5.19%"

SDK_NAME = "${DISTRO}-${TCLIBC}-${SDKMACHINE}-${IMAGE_BASENAME}-${TUNE_PKGARCH}-${MACHINE}"
SDKPATHINSTALL = "/opt/${DISTRO}/${SDK_VERSION}"

DISTRO_EXTRA_RDEPENDS += "${POKY_DEFAULT_EXTRA_RDEPENDS}"
DISTRO_EXTRA_RRECOMMENDS += "${POKY_DEFAULT_EXTRA_RRECOMMENDS}"

TCLIBCAPPEND = ""

SANITY_TESTED_DISTROS ?= " \
            poky-3.3 \n \
            poky-3.4 \n \
            ubuntu-16.04 \n \
            ubuntu-18.04 \n \
            ubuntu-20.04 \n \
            ubuntu-21.10 \n \
            ubuntu-22.04 \n \
            fedora-34 \n \
            fedora-35 \n \
            centos-7 \n \
            centos-8 \n \
            debian-9 \n \
            debian-10 \n \
            debian-11 \n \
            opensuseleap-15.3 \n \
            almalinux-8.5 \n \
            "
# add poky sanity bbclass
INHERIT += "poky-sanity"

# QA check settings - a little stricter than the OE-Core defaults
# (none currently necessary as we now match OE-Core)
#WARN_TO_ERROR_QA = "X"
#WARN_QA_remove = "${WARN_TO_ERROR_QA}"
#ERROR_QA_append = " ${WARN_TO_ERROR_QA}"

require conf/distro/include/poky-world-exclude.inc
require conf/distro/include/no-static-libs.inc
require conf/distro/include/yocto-uninative.inc
require conf/distro/include/security_flags.inc
INHERIT += "uninative"

BB_SIGNATURE_HANDLER ?= "OEEquivHash"
BB_HASHSERVE ??= "auto"
```

## conf/layer.conf
```bitbake
# We have a conf and classes directory, add to BBPATH
BBPATH .= ":${LAYERDIR}"

# We have recipes-* directories, add to BBFILES
BBFILES += "${LAYERDIR}/recipes-*/*/*.bb \
            ${LAYERDIR}/recipes-*/*/*.bbappend"

BBFILE_COLLECTIONS += "meta-rodeos"
BBFILE_PATTERN_meta-rodeos = "^${LAYERDIR}/"
BBFILE_PRIORITY_meta-rodeos = "6"

LAYERDEPENDS_meta-rodeos = "core openembedded-layer virtualization-layer cloud-services-layer networking-layer filesystems-layer meta-python"
LAYERSERIES_COMPAT_meta-rodeos = "kirkstone"
BBFILE_PRIORITY_openembedded-layer = "4"
```
